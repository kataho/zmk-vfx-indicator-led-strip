## Kconfig
```kconfig
menuconfig INDICATOR_LED_STRIP
  bool "Enable indicators with LED strip"
  select LED_STRIP
  select ZMK_LOW_PRIORITY_WORK_QUEUE
  select SPI

if INDICATOR_LED_STRIP

# Settings
config INDICATOR_LED_STRIP_EXT_POWER
    bool "Indicators with LED strip toggling also controls external power"

config INDICATOR_LED_STRIP_ON_START
    bool "Indicators with LED strip starts on by default"
    default y

endif # INDICATOR_LED_STRIP

DT_COMPAT_ZMK_BEHAVIOR_INDICATOR_LED_STRIP := zmk,behavior-indicator-led-strip

config ZMK_BEHAVIOR_INDICATOR_LED_STRIP
    bool
    default $(dt_compat_enabled,$(DT_COMPAT_ZMK_BEHAVIOR_INDICATOR_LED_STRIP))
```

## dts/bindings/behaviors/zmk,behavior-indicator-led-strip.yaml
```yaml
description: Indicators with LED strip behavior

compatible: "zmk,behavior-indicator-led-strip"

include: zero_param.yaml

properties:
  toggle:
    type: boolean
```
